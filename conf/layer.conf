## conf/layer.conf
```bitbake
BBPATH .= ":${LAYERDIR}"

BBFILES += "\
    ${LAYERDIR}/recipes-*/*/*.bb \
    ${LAYERDIR}/recipes-*/*/*.bbappend \
"

BBFILE_COLLECTIONS += "meta-boundary-extra"
BBFILE_PATTERN_meta-boundary-extra = "^${LAYERDIR}/"
BBFILE_PRIORITY_meta-boundary-extra = "9"

LAYERDEPENDS_meta-boundary-extra += "core openembedded-layer freescale-layer boundary-layer"

LAYERSERIES_COMPAT_meta-boundary-extra = "scarthgap"
```

## wic/sdimage-nitrogen8mp.wks
```
# Create a partitioned SD card image with a boot partition and a root partition

part /boot --source bootimg-partition --ondisk mmcblk1 --fstype=vfat --label boot --active --align 4 --size 16
part / --source rootfs --ondisk mmcblk1 --fstype=ext4 --label root --align 4
```
